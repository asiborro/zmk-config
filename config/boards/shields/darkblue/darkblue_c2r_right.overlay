/*
 * Copyright (c) 2022 The ZMK Contributors
 *
 * SPDX-License-Identifier: MIT
 */

#include "darkblue_c2r.dtsi"

&bootloader_key_right {
    status = "okay";
};

/ {

};

&default_transform {
    col-offset = <7>;
};
