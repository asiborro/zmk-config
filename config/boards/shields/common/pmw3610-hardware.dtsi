/* PMW3610 on VIK; the shift register uses SPI chip select 0. */
&spi1 {
    cs-gpios = <&gpio0 4 GPIO_ACTIVE_LOW>, <&gpio0 8 GPIO_ACTIVE_LOW>;

    trackball: trackball@1 {
        compatible = "pixart,pmw3610";
        status = "okay";
        reg = <1>;
        spi-max-frequency = <2000000>;
        irq-gpios = <&gpio0 31 (GPIO_ACTIVE_LOW | GPIO_PULL_UP)>;
    };
};
