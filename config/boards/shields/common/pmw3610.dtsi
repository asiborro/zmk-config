/* A directly connected sensor, as used by darkblue's right central. */
#include "pmw3610-hardware.dtsi"
#include "trackball-input.dtsi"

&trackball_listener {
    status = "okay";
    device = <&trackball>;
};
