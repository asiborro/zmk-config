/*
 * Copyright (c) 2022 The ZMK Contributors
 *
 * SPDX-License-Identifier: MIT
 */

#include "roseblue_r2c.dtsi"

&bootloader_key_left {
    status = "okay";
};

/* Process the right sensor's forwarded motion on the left central. */
&trackball_listener {
    status = "okay";
};
