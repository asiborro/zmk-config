## config/Kconfig
```kconfig
# SPDX-License-Identifier: MIT
# Boot-key options from rianadon/zmk at
# 4fc05c26b8faa35081282d58abc84fb6bd1b52bd (app/Kconfig).

DT_COMPAT_ZMK_BOOT_MAGIC_KEY := zmk,boot-magic-key
config ZMK_BOOT_MAGIC_KEY
    bool "Enable actions when keys are held at boot"
    default $(dt_compat_enabled,$(DT_COMPAT_ZMK_BOOT_MAGIC_KEY))

config ZMK_BOOT_MAGIC_KEY_TIMEOUT_MS
    int "Milliseconds to wait for a boot magic key at startup"
    default 500

config PEAMK_BATTERY_TELEMETRY
    bool "PeaMK supply voltage and power-source telemetry"
    depends on ZMK_BLE && ZMK_BATTERY && SOC_NRF52840_QIAA
    help
      Expose sampled VDDH voltage, inferred USB power, RGB state and sample age.
      On the central, relay one split peripheral's telemetry as well.

config PEAMK_TRACKBALL_TELEMETRY
    bool "PeaMK passive PMW3610 quality diagnostics"
    depends on PEAMK_BATTERY_TELEMETRY && PMW3610 && ZMK_SPLIT_ROLE_CENTRAL
    help
      Cache SQUAL, shutter, startup status and SPI read errors from existing
      driver operations. Bluetooth reads do not perform sensor I/O or wake it.

config PEAMK_TRACKBALL_USB_TELEMETRY
    bool "PeaMK trackball diagnostics on the USB debug console"
    depends on PEAMK_TRACKBALL_TELEMETRY && ZMK_USB_LOGGING && UART_LINE_CTRL && LOG
    help
      Log the cached quality packet every two seconds while USB is configured,
      awake and its serial console is open. No extra sensor reads are made.
```

## config/boards/shields/darkblue/Kconfig.defconfig
```kconfig
# Copyright (c) 2022 The ZMK Contributors
# SPDX-License-Identifier: MIT

if SHIELD_DARKBLUE_RIGHT

config ZMK_KEYBOARD_NAME
    default "darkblue"

config ZMK_SPLIT_ROLE_CENTRAL
    default y

endif # SHIELD_DARKBLUE_RIGHT

if SHIELD_DARKBLUE_LEFT || SHIELD_DARKBLUE_RIGHT

config ZMK_SPLIT
    default y

config SPI
    default y

config ZMK_RGB_UNDERGLOW
    default y
    select WS2812_STRIP
    select SPI

config ZMK_RGB_UNDERGLOW_BRT_START
    default 50

config ZMK_RGB_UNDERGLOW_EFF_START
    default 3

endif # SHIELD_DARKBLUE_LEFT || SHIELD_DARKBLUE_RIGHT
```

## config/boards/shields/darkblue/Kconfig.shield
```kconfig
# Copyright (c) 2022 The ZMK Contributors
# SPDX-License-Identifier: MIT

config SHIELD_DARKBLUE_LEFT
    bool "darkblue Left"
    default y if $(shields_list_contains,darkblue_r2c_left)
    default y if $(shields_list_contains,darkblue_c2r_left)

config SHIELD_DARKBLUE_RIGHT
    bool "darkblue Right"
    default y if $(shields_list_contains,darkblue_r2c_right)
    default y if $(shields_list_contains,darkblue_c2r_right)
```

## config/boards/shields/roseblue/Kconfig.defconfig
```kconfig
# Copyright (c) 2022 The ZMK Contributors
# SPDX-License-Identifier: MIT

if SHIELD_ROSEBLUE_RIGHT

config ZMK_KEYBOARD_NAME
    default "roseblue"

config ZMK_SPLIT_ROLE_CENTRAL
    default y

endif # SHIELD_ROSEBLUE_RIGHT

if SHIELD_ROSEBLUE_LEFT || SHIELD_ROSEBLUE_RIGHT

config ZMK_SPLIT
    default y

config SPI
    default y

config ZMK_RGB_UNDERGLOW
    default y
    select WS2812_STRIP
    select SPI

config ZMK_RGB_UNDERGLOW_BRT_START
    default 50

config ZMK_RGB_UNDERGLOW_EFF_START
    default 3

endif # SHIELD_ROSEBLUE_LEFT || SHIELD_ROSEBLUE_RIGHT
```

## config/boards/shields/roseblue/Kconfig.shield
```kconfig
# Copyright (c) 2022 The ZMK Contributors
# SPDX-License-Identifier: MIT

config SHIELD_ROSEBLUE_LEFT
    bool "roseblue Left"
    default y if $(shields_list_contains,roseblue_r2c_left)
    default y if $(shields_list_contains,roseblue_c2r_left)

config SHIELD_ROSEBLUE_RIGHT
    bool "roseblue Right"
    default y if $(shields_list_contains,roseblue_r2c_right)
    default y if $(shields_list_contains,roseblue_c2r_right)
```
